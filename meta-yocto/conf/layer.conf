## meta-yocto/conf/layer.conf
```bitbake
# Dummy file to allow for meta-yocto -> meta-poky transition
BBPATH =. "${LAYERDIR}/../meta-poky:"

# Define a dummy collection to make layerindex can add it for new layerbranch.
BBFILE_COLLECTIONS += "yocto-dummy"
```
